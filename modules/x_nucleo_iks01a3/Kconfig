## modules/x_nucleo_iks01a3/Kconfig
```kconfig
# Copyright (c) 2023 Kasper Hjort Berthelsen
#
# This file is subject to the terms and conditions of the GNU Lesser
# General Public License v2.1. See the file LICENSE in the top level
# directory for more details.

config MODULE_X_NUCLEO_IKS01A3
    bool "ST X-NUCLEO-IKS01A3"
    depends on TEST_KCONFIG
    select MODULE_HTS221
    select MODULE_LPSXXX
```
